## app/build/Kconfig/boards/Kconfig.defconfig.tmp
```kconfig
# Load Zephyr board defconfig descriptions.
osource "C:/Users/user/zephyrproject/zephyr/boards/nordic/nrf52840dk/Kconfig.defconfig"
```

## app/build/Kconfig/boards/Kconfig.nrf52840dk.tmp
```kconfig
# Load board Kconfig descriptions.
osource "C:/Users/user/zephyrproject/zephyr/boards/nordic/nrf52840dk/Kconfig.nrf52840dk"
```

## app/build/Kconfig/boards/Kconfig.tmp
```kconfig
# Load Zephyr board Kconfig descriptions.
osource "C:/Users/user/zephyrproject/zephyr/boards/nordic/nrf52840dk/Kconfig"
```
