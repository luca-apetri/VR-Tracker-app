## CMakeLists.txt
```
#-------------------------------------------------------------------------------
# Zephyr Example Application
#
# Copyright (c) 2021 Nordic Semiconductor ASA
# SPDX-License-Identifier: Apache-2.0

cmake_minimum_required(VERSION 3.20.0)
find_package(Zephyr REQUIRED HINTS $ENV{ZEPHYR_BASE})

project(VR_Tracker_app LANGUAGES C)

target_sources(app PRIVATE src/main.c)

# The code below locates the git index file for this repository and adds it as a dependency for
# the application VERSION file so that if the repo has a new commit added, even if no files in
# the build have changed, the application version file will be regenerated with the new git commit
find_package(Git QUIET)
if(GIT_FOUND)
  execute_process(
    COMMAND ${GIT_EXECUTABLE} rev-parse --absolute-git-dir
    WORKING_DIRECTORY .
    OUTPUT_VARIABLE application_git_dir
    OUTPUT_STRIP_TRAILING_WHITESPACE
    ERROR_STRIP_TRAILING_WHITESPACE
    ERROR_VARIABLE stderr
    RESULT_VARIABLE return_code
  )
  # If there is an error e.g. it is not a git repo, we just silently ignore it and continue
  # without a dependency, this will be the case with freestanding applications.
  if(NOT return_code)
    if(NOT "${stderr}" STREQUAL "")
      message(WARNING "Application build version git rev-parse warned: ${stderr}")
    endif()

    set_property(TARGET app_version_h PROPERTY APP_VERSION_DEPENDS ${application_git_dir}/index)
  endif()
endif()
```

## sample.yaml
```
# This file configures Twister to test your VR Tracker across your target hardware.
sample:
  description: VR Tracker Application firmware test
  name: vr-tracker-app

common:
  build_only: true
  # Tell the automated runner to test this code against the nRF52840 DK
  platform_allow:
    - nrf52840dk/nrf52840

tests:
  app.default: {}
```

## prj.conf
```kconfig
# Copyright (c) 2021 Nordic Semiconductor ASA
# SPDX-License-Identifier: Apache-2.0
#
# This file contains selected Kconfig options for the application.

CONFIG_PRINTK=y #DISABLE for release
CONFIG_SENSOR=y

# Example: Turn these on later when you connect your sensors & tracking
CONFIG_I2C=y
# CONFIG_BT=y
# CONFIG_BT_PERIPHERAL=y
```

## src/main.c
```c
/*
 * Copyright (c) 2026 Nordic Semiconductor ASA
 * SPDX-License-Identifier: Apache-2.0
 */

#include <zephyr/kernel.h>
#include <zephyr/sys/printk.h>
#include <zephyr/drivers/gpio.h>

/* The nrf52840dk has an LED built-in called "led0" in its devicetree */
#define LED0_NODE DT_ALIAS(led0)
static const struct gpio_dt_spec led = GPIO_DT_SPEC_GET(LED0_NODE, gpios);

int main(void)
{
    int ret;

    printk("VR Tracker App Initializing...\n");

    /* Check if the hardware LED is ready */
    if (!gpio_is_ready_dt(&led)) {
        printk("Error: Built-in LED device is not ready\n");
        return 0;
    }

    /* Configure the LED pin as an output */
    ret = gpio_pin_configure_dt(&led, GPIO_OUTPUT_ACTIVE);
    if (ret < 0) {
        printk("Error: Could not configure LED pin (%d)\n", ret);
        return 0;
    }

    printk("Success! VR Tracker baseline code running smoothly.\n");

    while (1) {
        /* Toggle the LED on and off every 500ms */
        gpio_pin_toggle_dt(&led);
        k_msleep(500);
    }

    return 0;
}
```
